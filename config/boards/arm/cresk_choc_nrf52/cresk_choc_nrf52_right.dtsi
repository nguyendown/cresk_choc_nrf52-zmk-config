/*
 * Copyright (c) 2023 The ZMK Contributors
 *
 * SPDX-License-Identifier: MIT
 */

&kscan0 {
	input-gpios
		= <&gpio0  6 (GPIO_ACTIVE_LOW | GPIO_PULL_UP)>
		, <&gpio0 26 (GPIO_ACTIVE_LOW | GPIO_PULL_UP)>
		, <&gpio0 31 (GPIO_ACTIVE_LOW | GPIO_PULL_UP)>
		, <&gpio0 29 (GPIO_ACTIVE_LOW | GPIO_PULL_UP)>
		, <&gpio0  3 (GPIO_ACTIVE_LOW | GPIO_PULL_UP)>
		, <&gpio0  5 (GPIO_ACTIVE_LOW | GPIO_PULL_UP)>
		, <&gpio0  8 (GPIO_ACTIVE_LOW | GPIO_PULL_UP)>
		, <&gpio0  4 (GPIO_ACTIVE_LOW | GPIO_PULL_UP)>
		, <&gpio0 30 (GPIO_ACTIVE_LOW | GPIO_PULL_UP)>
		, <&gpio0  2 (GPIO_ACTIVE_LOW | GPIO_PULL_UP)>
		, <&gpio0 12 (GPIO_ACTIVE_LOW | GPIO_PULL_UP)>
		, <&gpio0 15 (GPIO_ACTIVE_LOW | GPIO_PULL_UP)>
		, <&gpio0  7 (GPIO_ACTIVE_LOW | GPIO_PULL_UP)>
		, <&gpio0 17 (GPIO_ACTIVE_LOW | GPIO_PULL_UP)>
		, <&gpio0 13 (GPIO_ACTIVE_LOW | GPIO_PULL_UP)>
		, <&gpio0 20 (GPIO_ACTIVE_LOW | GPIO_PULL_UP)>
		, <&gpio0 22 (GPIO_ACTIVE_LOW | GPIO_PULL_UP)>
		;
};

&default_transform {
	col-offset = <17>;
};
