## config/boards/arm/cresk_choc_nrf52/Kconfig
```kconfig
# Copyright (c) 2023 The ZMK Contributors
# SPDX-License-Identifier: MIT

config BOARD_CRESK_CHOC_NRF52
	bool
	default y if BOARD_CRESK_CHOC_NRF52840_LEFT || BOARD_CRESK_CHOC_NRF52833_RIGHT || BOARD_CRESK_CHOC_NRF52833_LEFT || BOARD_CRESK_CHOC_NRF52833_RIGHT

config BOARD_ENABLE_DCDC
	bool "Enable DCDC mode"
	select SOC_DCDC_NRF52X
	default y
	depends on BOARD_CRESK_CHOC_NRF52
```

## config/boards/arm/cresk_choc_nrf52/Kconfig.board
```kconfig
# Copyright (c) 2023 The ZMK Contributors
# SPDX-License-Identifier: MIT

config BOARD_CRESK_CHOC_NRF52840_LEFT
	bool "cresk_choc_nrf52840_left"
	depends on SOC_NRF52840_QIAA

config BOARD_CRESK_CHOC_NRF52840_RIGHT
	bool "cresk_choc_nrf52840_right"
	depends on SOC_NRF52840_QIAA

config BOARD_CRESK_CHOC_NRF52833_LEFT
	bool "cresk_choc_nrf52833_left"
	depends on SOC_NRF52833_QIAA

config BOARD_CRESK_CHOC_NRF52833_RIGHT
	bool "cresk_choc_nrf52833_right"
	depends on SOC_NRF52833_QIAA
```

## config/boards/arm/cresk_choc_nrf52/Kconfig.defconfig
```kconfig
# Copyright (c) 2023 The ZMK Contributors
# SPDX-License-Identifier: MIT

if BOARD_CRESK_CHOC_NRF52840_LEFT || BOARD_CRESK_CHOC_NRF52833_LEFT

config ZMK_KEYBOARD_NAME
	default "cresk_choc_nrf52"

config ZMK_SPLIT_ROLE_CENTRAL
	default y

endif # BOARD_CRESK_CHOC_NRF52840_LEFT || BOARD_CRESK_CHOC_NRF52833_LEFT

if BOARD_CRESK_CHOC_NRF52

config BOARD
	default "cresk_choc_nrf52"

config ZMK_SPLIT
	default y

config BT_CTLR
	default BT

if USB

config USB_NRFX
	default y

config USB_DEVICE_STACK
	default y

endif # USB

endif # BOARD_CRESK_CHOC_NRF52
```

## config/west.yml
```yaml
manifest:
  defaults:
    revision: v0.2
  remotes:
    - name: zmkfirmware
      url-base: https://github.com/zmkfirmware
    - name: nguyendown
      url-base: https://github.com/nguyendown
    # Additional modules containing boards/shields/custom code can be listed here as well
    # See https://docs.zephyrproject.org/3.2.0/develop/west/manifest.html#projects
  projects:
    - name: zmk
      remote: zmkfirmware
      import: app/west.yml
    - name: zmk-cresk-module
      remote: nguyendown
      revision: main
    - name: zmk-behavior-sticky2
      remote: nguyendown
      revision: main
  self:
    path: config
```
